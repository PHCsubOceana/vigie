## vigie-corps/main/Kconfig.projbuild
```kconfig
menu "Vigie"

    config VIGIE_WIFI_SSID
        string "Réseau Wi-Fi (2,4 GHz)"
        default ""
        help
            Nom du réseau Wi-Fi de la maison. La carte ne capte que le 2,4 GHz.
            Sert au premier démarrage : un réseau choisi ensuite sur l'écran
            (Réglages, Wi-Fi) le remplace et reste en mémoire.

    config VIGIE_WIFI_PASSWORD
        string "Mot de passe Wi-Fi"
        default ""

    config VIGIE_MQTT_URI
        string "Adresse du broker MQTT (Jetson)"
        default "mqtt://192.168.1.50:1883"
        help
            Remplacer 192.168.1.50 par l'adresse IP du Jetson (à réserver dans la box).

    config VIGIE_MQTT_USER
        string "Utilisateur MQTT"
        default "vigie"

    config VIGIE_MQTT_PASSWORD
        string "Mot de passe MQTT"
        default ""

    config VIGIE_VOLUME
        int "Volume au premier démarrage (0 = muet)"
        range 0 100
        default 60
        help
            Ensuite, le volume se règle sur l'écran (Réglages, Son) et reste en mémoire.

    menu "Caméra"

        config VIGIE_CAMERA
            bool "Caméra OV5647 (connecteur MIPI-CSI)"
            default y

        config VIGIE_CAM_HFLIP
            int "Miroir horizontal du capteur (0 ou 1)"
            range 0 1
            default 1
            depends on VIGIE_CAMERA
            help
                Dans l'aperçu (qui est un miroir), lever la main droite doit la montrer
                du côté droit de l'écran. Sinon, changer cette valeur.

        config VIGIE_CAM_VFLIP
            int "Retournement vertical du capteur (0 ou 1)"
            range 0 1
            default 1
            depends on VIGIE_CAMERA
            help
                Si l'aperçu est à l'envers, changer cette valeur.

        config VIGIE_VISAGE
            bool "Détection de visage (ESP-DL)"
            default y
            depends on VIGIE_CAMERA

        config VIGIE_ABSENCE_S
            int "Secondes sans visage avant de publier « absent »"
            default 60
            range 5 3600
            depends on VIGIE_CAMERA

    endmenu

    menu "Yeux"

        config VIGIE_YEUX
            bool "Yeux DualEye 0,71 pouce (connecteur 40 broches)"
            default y
            help
                Sans module branché, cette option ne gêne rien. Câblage dans le README.

        config VIGIE_YEUX_SPI_MHZ
            int "Vitesse du bus SPI (MHz)"
            range 5 40
            default 20
            depends on VIGIE_YEUX
            help
                20 MHz donne environ 25 images par seconde. Baisser si l'image
                est parasitée (fils longs), monter seulement avec des fils courts.

        config VIGIE_YEUX_LUMIERE
            int "Luminosité (%)"
            range 5 100
            default 80
            depends on VIGIE_YEUX

        config VIGIE_YEUX_OEIL1_RETOURNE
            bool "Œil 1 à l'envers (rotation de 180°)"
            default n
            depends on VIGIE_YEUX
            help
                Mire « yeux test » : la bande blanche doit être en haut.

        config VIGIE_YEUX_OEIL2_RETOURNE
            bool "Œil 2 à l'envers (rotation de 180°)"
            default n
            depends on VIGIE_YEUX

        config VIGIE_YEUX_BGR
            bool "Rouge et bleu inversés"
            default n
            depends on VIGIE_YEUX
            help
                Mire « yeux test » : l'œil 1 doit être rouge et l'œil 2 bleu.

        config VIGIE_YEUX_INVERSE_X
            bool "Le regard part du mauvais côté"
            default n
            depends on VIGIE_YEUX
            help
                Les yeux doivent suivre le visage. S'ils le fuient, activer cette option.

    endmenu

endmenu
```
